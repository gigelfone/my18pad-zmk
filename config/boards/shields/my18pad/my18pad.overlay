/ {
    chosen {
        zmk,kscan = &kscan0;
    };

    kscan0: kscan {
        compatible = "zmk,kscan-gpio-matrix";

        diode-direction = "row2col";

        row-gpios =
            <&gpio0 2 GPIO_ACTIVE_LOW>,
            <&gpio0 3 GPIO_ACTIVE_LOW>,
            <&gpio0 4 GPIO_ACTIVE_LOW>,
            <&gpio0 5 GPIO_ACTIVE_LOW>,
            <&gpio0 7 GPIO_ACTIVE_LOW>;

        col-gpios =
            <&gpio0 10 GPIO_ACTIVE_LOW>,
            <&gpio0 11 GPIO_ACTIVE_LOW>,
            <&gpio0 12 GPIO_ACTIVE_LOW>,
            <&gpio0 13 GPIO_ACTIVE_LOW>;
    };
};
